## boards/shields/page_turner/Kconfig.defconfig
```kconfig
if SHIELD_PAGE_TURNER

config ZMK_KEYBOARD_NAME
    default "Page Turner"

# 7 direct-GPIO keys (5 buttons + 2 encoder switches)
config ZMK_KSCAN_GPIO_POLL_PERIOD_MS
    default 10   # 10ms poll — snappy on breadboard wiring

endif # SHIELD_PAGE_TURNER
```

## config/boards/shields/page_turner/Kconfig.defconfig
```kconfig
if SHIELD_PAGE_TURNER

config ZMK_KEYBOARD_NAME
    default "Page Turner"

endif # SHIELD_PAGE_TURNER
```

## config/west.yml
```yaml
# ZMK west manifest — pinned to v0.3 (stable, pre-Zephyr 4.1)
# Stay on v0.3 until ZMK cuts v0.4 with the Zephyr 4.1 migration fully stable.
# To upgrade later: change revision to the new tag and update board name in build.yaml.
manifest:
  remotes:
    - name: zmkfirmware
      url-base: https://github.com/zmkfirmware
  projects:
    - name: zmk
      remote: zmkfirmware
      revision: v0.3
      import: app/west.yml
  self:
    path: config
```
